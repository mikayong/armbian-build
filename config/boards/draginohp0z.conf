## packages/dragino-h3/m700_defconfig
```kconfig
CONFIG_ARM=y
CONFIG_ARCH_SUNXI=y
CONFIG_SPL=y
CONFIG_SPL_LIBCOMMON_SUPPORT=y
CONFIG_MACH_SUN8I_H3=y
CONFIG_DRAM_CLK=624
CONFIG_MMC_SUNXI_SLOT_EXTRA=2
CONFIG_DEFAULT_DEVICE_TREE="sun8i-h3-m700-zero"
CONFIG_SUN8I_EMAC=y
#CONFIG_SY8106A_POWER=n
CONFIG_USB_EHCI_HCD=y
CONFIG_USB_OHCI_HCD=y
CONFIG_DISABLE_CONSOLE=y
CONFIG_SPL_SERIAL_SUPPORT=n
CONFIG_REQUIRE_SERIAL_CONSOLE=n
CONFIG_CONSOLE_NORMAL=n
CONFIG_CMD_CONSOLE=n
CONFIG_CONSOLE_MUX=n
CONFIG_SILENT_CONSOLE=y
CONFIG_SYS_CONSOLE_IS_IN_ENV=n
CONFIG_SYS_CONSOLE_OVERWRITE_ROUTINE=n
CONFIG_SYS_CONSOLE_ENV_OVERWRITE=n
CONFIG_SERIAL_PRESENT=n
CONFIG_SPL_SERIAL_PRESENT=n
CONFIG_SPECIFY_CONSOLE_INDEX=n
CONFIG_DM_SERIAL=n
CONFIG_CMD_VIDCONSOLE=n
CONFIG_ENV_SUPPORT=n
```
